#include "stm32f10x.h"
#include "ws2812.h"


uint16_t led_ws2812[ARRAY_LEN] = {0};

void led_wheel(uint8_t led, uint8_t r ,uint8_t g, uint8_t b)
{
  if (led < LED_COUNT)
  {
    for (uint8_t bits = 0; bits < 8; bits++)
      led_ws2812[DELAY_LEN + 24*led + bits] = led_pwm[g][bits];
    for (uint8_t bits = 0; bits < 8; bits++)
      led_ws2812[DELAY_LEN + 24*led + bits + 8] = led_pwm[r][bits];
    for (uint8_t bits = 0; bits < 8; bits++)
      led_ws2812[DELAY_LEN + 24*led + bits + 16] = led_pwm[b][bits];
  }
}

uint8_t tempo_cnt = 0;
uint8_t tempo_cnt1 = 1;
uint8_t tempo_cnt2 = 2;
void led_loop(void)
{
  if (tempo_cnt < (LED_COUNT - 1)) tempo_cnt++;
  else tempo_cnt = 0;
  if (tempo_cnt1 < (LED_COUNT - 1)) tempo_cnt1++;
  else tempo_cnt1 = 0;
  if (tempo_cnt2 < (LED_COUNT - 1)) tempo_cnt2++;
  else tempo_cnt2 = 0;
  for (uint8_t led_num = 0;led_num < LED_COUNT; led_num++)
  {
    if (tempo_cnt == led_num) led_wheel(led_num, 127, 0, 127);
    else if ((tempo_cnt1 == led_num) || (tempo_cnt2 == led_num)) led_wheel(led_num, 64, 0, 64);
    else led_wheel(led_num, 0, 0, 0);
  }
}
/*
void led_wheel(uint8_t led, uint8_t r ,uint8_t g, uint8_t b)
{
  
  for (uint16_t clr = DELAY_LEN; clr < ARRAY_LEN; )
  {   
    for (uint8_t bits = 0; bits < 8; bits++)
    {
      led_ws2812[clr] = led_pwm[r][cnt];
      clr++;
    }
    for (uint8_t bits = 0; bits < 8; bits++)
    {
      led_ws2812[clr] = led_pwm[g][cnt];
      clr++;
    }
    for (uint8_t bits = 0; bits < 8; bits++)
    {
      led_ws2812[clr] = led_pwm[b][cnt];
      clr++;
    }    
  } 
}*/

const uint16_t led_pwm[128][8] = 
{
24,24,24,24,24,24,24,24,
24,24,24,24,24,24,24,44, 
24,24,24,24,24,24,44, 24,
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24,44, 44, 44, 44, 44, 44, 44
};